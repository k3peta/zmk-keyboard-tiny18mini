## boards/shieds/tiny18mini/Kconfig.defconfig
```kconfig
if SHIELD_TINY18MINI_R

config ZMK_KEYBOARD_NAME
    default "tiny18mini"

config ZMK_BLE
    default y

config ZMK_SPLIT_ROLE_CENTRAL
    default y

endif

if SHIELD_TINY18MINI_R || SHIELD_TINY18MINI_L


config ZMK_SPLIT
    default y

config INPUT
    default y

config ZMK_POINTING
    default y


config RGBLED_WIDGET_BATTERY_LEVEL_HIGH
    default 30

config RGBLED_WIDGET_BATTERY_LEVEL_CRITICAL
    default 10

endif
```

## boards/shieds/tiny18mini/Kconfig.shield
```kconfig
config SHIELD_TINY18MINI_R
    def_bool $(shields_list_contains,tiny18mini_r)

config SHIELD_TINY18MINI_L
    def_bool $(shields_list_contains,tiny18mini_l)
```

## config/west.yml
```yaml
manifest:
  remotes:
    - name: zmkfirmware
      url-base: https://github.com/zmkfirmware
    - name: caksoylar
      url-base: https://github.com/caksoylar
  projects:
    - name: zmk
      remote: zmkfirmware
      revision: main
      import: true
    - name: zmk-rgbled-widget
      remote: caksoylar
      revision: main
  self:
    path: zmk-keyboard-tiny18mini
```
